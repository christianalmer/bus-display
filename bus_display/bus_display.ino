/*
 * Muni 23 Bus Departure Display
 * ------------------------------
 * Elecrow CrowPanel 2.13" e-paper (ESP32-S3) + 511.org StopMonitoring API
 * Stop: Crescent Ave & Andover St, toward Glen Park (511 stop ID 14189)
 *
 * Behavior:
 *   - Polls 511 once per minute (free tier = 60 req/hr)
 *   - Shows minutes until next departure, second departure smaller below
 *   - Fast DU refresh when the displayed minutes change
 *   - Full GC refresh every 15 fast refreshes to clear ghosting
 *   - "No buses" at night / when no predictions
 *
 * Display stack: vendored Elecrow SSD1680 driver (epd1680.cpp) + Adafruit
 * GFX drawing into an off-screen 1-bit canvas. This unit is the older
 * CrowPanel revision (SSD1680 panel; the newer JD79661 revision's driver
 * is kept in extras/jd79661). GxEPD2 was tried and dropped: its
 * GxEPD2_213_BN partial-refresh LUT doesn't match this panel and ghosts
 * badly; Elecrow's flow uses the panel's own OTP Mode-2 waveform instead.
 *
 * Libraries (Library Manager): Adafruit GFX, ArduinoJson (v7)
 *
 * Board settings (per Elecrow tutorial): "ESP32S3 Dev Module",
 * PSRAM: OPI PSRAM, Partition scheme: Huge APP (3MB No OTA/1MB SPIFFS)
 */

#include <WiFi.h>
#include <WiFiClientSecure.h>
#include <HTTPClient.h>
#include <ArduinoJson.h>
#include <Adafruit_GFX.h>
#include <Fonts/FreeSansBold24pt7b.h>
#include <Fonts/FreeSansBold12pt7b.h>
#include <Fonts/FreeSans9pt7b.h>
#include <time.h>
#include <Preferences.h>
#include "epd1680.h"
#include "schedule.h"  // generated by tools/gen_schedule.py (baked-in fallback)

// ======================= CONFIG =======================
#include "secrets.h"  // gitignored; copy secrets.h.example and fill in
const char* WIFI_SSID   = SECRET_WIFI_SSID;
const char* WIFI_PASS   = SECRET_WIFI_PASS;
const char* API_KEY_511 = SECRET_API_KEY_511;

// Published by GitHub Actions (tools/gen_schedule.py runs weekly in CI);
// fetched daily so the baked-in schedule.h never goes stale.
const char* SCHEDULE_URL =
    "https://raw.githubusercontent.com/christianalmer/bus-display/main/schedule.json";
const char* STOP_CODE   = "14189";            // Crescent & Andover, toward Glen Park
const char* AGENCY      = "SF";               // SF Muni
const char* LINE_REF    = "23";

const uint32_t FETCH_INTERVAL_MS   = 65UL * 1000UL;  // rate limit is 60/hr; leave headroom
const uint8_t  FULL_REFRESH_EVERY  = 5;              // partials between full refreshes (ghosting)
const char*    TZ_STRING = "PST8PDT,M3.2.0,M11.1.0/2";  // America/Los_Angeles

// ======================= DISPLAY =======================
// Draw in landscape 250x122 on a 1-bit canvas, then translate to the
// panel's portrait RAM layout (matches Elecrow demo EPD_DrawPoint with
// USE_HORIZONTIAL == 2; bit set = black, inverted on the wire by driver).
GFXcanvas1 canvas(250, 122);
uint8_t epdBuf[EPD_BUF_BYTES];

void canvasToPanel() {
  memset(epdBuf, 0x00, sizeof(epdBuf));
  for (int16_t y = 0; y < 122; y++) {
    for (int16_t x = 0; x < 250; x++) {
      if (!canvas.getPixel(x, y)) continue;
      epdBuf[(uint32_t)(249 - x) * EPD_BYTES_PER_ROW + (y >> 3)] |= 0x80 >> (y & 7);
    }
  }
}

// ======================= STATE =======================
#define MAX_DEPARTURES 3
#define MAX_PREDICTIONS 6
time_t  departures[MAX_DEPARTURES];   // merged schedule+predictions, ascending
uint8_t departureCount = 0;
time_t   predTimes[MAX_PREDICTIONS];  // live predictions from 511
uint32_t predTrips[MAX_PREDICTIONS];  // their trip ids (numeric prefix)
uint8_t  predCount = 0;
uint32_t predFreshMs = 0;             // millis() of last successful fetch
int     lastShownMinutes = -999;
uint8_t partialsSinceFull = 0;
uint32_t lastFetchMs = 0;
bool    fetchOk = false;

// ======================= RUNTIME SCHEDULE =======================
// RAM copy of the schedule, loaded from the NVS-cached download when
// available, else from the baked-in schedule.h. Refreshed daily from
// SCHEDULE_URL so it outlives the ~5-week GTFS validity window.
#define RS_MAX_PATTERNS 8
#define RS_MAX_ENTRIES  64
#define RS_MAX_DAYS     70
struct RtSched {
  long     firstDay;                 // day serial of dayPattern[0]
  int16_t  dayCount;
  int8_t   dayPattern[RS_MAX_DAYS];  // -1 = no service data
  uint8_t  patternCount;
  uint16_t patLen[RS_MAX_PATTERNS];
  uint16_t minutes[RS_MAX_PATTERNS][RS_MAX_ENTRIES];
  uint32_t trips[RS_MAX_PATTERNS][RS_MAX_ENTRIES];
};
RtSched sched;
Preferences prefs;
uint32_t lastSchedFetchMs = 0;
uint32_t schedRetryMs = 24UL * 60UL * 60UL * 1000UL;  // shortened to 1h on failure

void loadBakedSchedule() {
  sched.firstDay = SCHED_FIRST_DAY;
  sched.dayCount = SCHED_DAY_COUNT < RS_MAX_DAYS ? SCHED_DAY_COUNT : RS_MAX_DAYS;
  for (int16_t i = 0; i < sched.dayCount; i++) sched.dayPattern[i] = SCHED_DAY_PATTERN[i];
  uint8_t pc = sizeof(SCHED_PATTERNS) / sizeof(SCHED_PATTERNS[0]);
  sched.patternCount = pc < RS_MAX_PATTERNS ? pc : RS_MAX_PATTERNS;
  for (uint8_t p = 0; p < sched.patternCount; p++) {
    sched.patLen[p] = SCHED_PATTERN_LEN[p] < RS_MAX_ENTRIES ? SCHED_PATTERN_LEN[p] : RS_MAX_ENTRIES;
    for (uint16_t i = 0; i < sched.patLen[p]; i++) {
      sched.minutes[p][i] = SCHED_PATTERNS[p][i].minutes;
      sched.trips[p][i] = SCHED_PATTERNS[p][i].trip;
    }
  }
  Serial.println("schedule: using baked-in table");
}

bool parseScheduleJson(const char* text) {
  JsonDocument doc;
  if (deserializeJson(doc, text)) return false;
  if (doc["v"].as<int>() != 1) return false;
  JsonArray days = doc["day_pattern"].as<JsonArray>();
  JsonArray pats = doc["patterns"].as<JsonArray>();
  if (days.isNull() || pats.isNull() || pats.size() == 0 ||
      pats.size() > RS_MAX_PATTERNS)
    return false;

  RtSched s;
  s.firstDay = doc["first_day"].as<long>();
  s.dayCount = 0;
  for (JsonVariant v : days) {
    if (s.dayCount >= RS_MAX_DAYS) break;
    s.dayPattern[s.dayCount++] = v.as<int>();
  }
  s.patternCount = 0;
  for (JsonObject p : pats) {
    JsonArray m = p["m"].as<JsonArray>(), t = p["t"].as<JsonArray>();
    if (m.isNull() || t.isNull() || m.size() != t.size() || m.size() > RS_MAX_ENTRIES)
      return false;
    uint8_t pi = s.patternCount;
    s.patLen[pi] = m.size();
    for (uint16_t i = 0; i < s.patLen[pi]; i++) {
      s.minutes[pi][i] = m[i].as<int>();
      s.trips[pi][i] = t[i].as<uint32_t>();
    }
    s.patternCount++;
  }
  sched = s;
  return true;
}

bool fetchRemoteSchedule() {
  WiFiClientSecure client;
  client.setInsecure();
  HTTPClient http;
  if (!http.begin(client, SCHEDULE_URL)) return false;
  int code = http.GET();
  if (code != 200) { http.end(); return false; }
  String body = http.getString();
  http.end();
  if (!parseScheduleJson(body.c_str())) return false;
  prefs.begin("bus", false);
  prefs.putString("sched", body);
  prefs.end();
  Serial.printf("schedule: remote updated (%u bytes, firstDay %ld, %d days)\n",
                body.length(), sched.firstDay, sched.dayCount);
  return true;
}

void initSchedule() {
  loadBakedSchedule();
  prefs.begin("bus", true);
  String cached = prefs.getString("sched", "");
  prefs.end();
  if (cached.length() && parseScheduleJson(cached.c_str()))
    Serial.printf("schedule: using cached download (firstDay %ld, %d days)\n",
                  sched.firstDay, sched.dayCount);
}

// ======================= GZIP =======================
// 511 always gzips JSON responses, even without Accept-Encoding.
// We inflate with miniz's tinfl, which lives in the ESP32-S3 ROM
// (esp_rom/include/miniz.h; verified in esp32s3.rom.ld for core 3.3.11).
#include "miniz.h"

// Returns malloc'd buffer with inflated data (caller frees), or nullptr.
uint8_t* gunzip(const uint8_t* in, size_t inLen, size_t* outLen) {
  if (inLen < 18 || in[0] != 0x1f || in[1] != 0x8b) return nullptr;
  // Skip 10-byte header + optional fields
  size_t p = 10;
  uint8_t flg = in[3];
  if (flg & 0x04) { // FEXTRA
    if (p + 2 > inLen) return nullptr;
    uint16_t xlen = in[p] | (in[p + 1] << 8);
    p += 2 + xlen;
  }
  if (flg & 0x08) { while (p < inLen && in[p++] != 0); } // FNAME
  if (flg & 0x10) { while (p < inLen && in[p++] != 0); } // FCOMMENT
  if (flg & 0x02) { p += 2; }                            // FHCRC
  if (p >= inLen - 8) return nullptr;

  // ISIZE (uncompressed length) = last 4 bytes, little-endian
  size_t isize = in[inLen - 4] | (in[inLen - 3] << 8) |
                 (in[inLen - 2] << 16) | ((size_t)in[inLen - 1] << 24);
  if (isize == 0 || isize > 512 * 1024) return nullptr;

  uint8_t* out = (uint8_t*)malloc(isize + 1);
  if (!out) return nullptr;

  size_t got = tinfl_decompress_mem_to_mem(
      out, isize, in + p, inLen - p - 8, 0 /* raw deflate */);
  if (got == TINFL_DECOMPRESS_MEM_TO_MEM_FAILED) { free(out); return nullptr; }
  out[got] = '\0';
  *outLen = got;
  return out;
}

// ======================= TIME HELPERS =======================
// Days-from-civil algorithm (Howard Hinnant), avoids timezone headaches.
// Also the day-serial convention used by schedule.h (SCHED_FIRST_DAY).
long daysFromCivil(int y, int mo, int d) {
  int yy = y - (mo <= 2);
  int era = (yy >= 0 ? yy : yy - 399) / 400;
  unsigned yoe = (unsigned)(yy - era * 400);
  unsigned doy = (153 * (mo + (mo > 2 ? -3 : 9)) + 2) / 5 + d - 1;
  unsigned doe = yoe * 365 + yoe / 4 - yoe / 100 + doy;
  return era * 146097L + (long)doe - 719468L;
}

// Parse "2026-08-11T22:31:00Z" (UTC) -> epoch seconds.
time_t parseIso8601Utc(const char* s) {
  int y, mo, d, h, mi, sec;
  if (sscanf(s, "%d-%d-%dT%d:%d:%d", &y, &mo, &d, &h, &mi, &sec) != 6) return 0;
  return (time_t)daysFromCivil(y, mo, d) * 86400 + h * 3600 + mi * 60 + sec;
}

// ======================= 511 FETCH =======================
bool fetchPredictions() {
  WiFiClientSecure client;
  client.setInsecure();  // fine for public transit data; pin a cert later if you like

  String url = String("https://api.511.org/transit/StopMonitoring?api_key=") +
               API_KEY_511 + "&agency=" + AGENCY + "&stopcode=" + STOP_CODE +
               "&format=json";

  HTTPClient http;
  if (!http.begin(client, url)) return false;
  int code = http.GET();
  if (code != 200) { http.end(); return false; }

  // Read the (gzipped) body fully into RAM — typically only a few KB
  String body = http.getString();
  http.end();

  size_t jsonLen = 0;
  uint8_t* json = gunzip((const uint8_t*)body.c_str(), body.length(), &jsonLen);
  const char* text;
  if (json) {
    text = (const char*)json;
  } else if (body.length() && body[0] == '{') {
    text = body.c_str();  // in case it ever arrives uncompressed
    jsonLen = body.length();
  } else {
    return false;
  }

  // 511 responses start with a UTF-8 BOM — skip it or ArduinoJson chokes
  if (jsonLen >= 3 && (uint8_t)text[0] == 0xEF) text += 3;

  // Filter to keep parsing memory small
  JsonDocument filter;
  filter["ServiceDelivery"]["StopMonitoringDelivery"]["MonitoredStopVisit"][0]
        ["MonitoredVehicleJourney"]["LineRef"] = true;
  filter["ServiceDelivery"]["StopMonitoringDelivery"]["MonitoredStopVisit"][0]
        ["MonitoredVehicleJourney"]["FramedVehicleJourneyRef"]["DatedVehicleJourneyRef"] = true;
  filter["ServiceDelivery"]["StopMonitoringDelivery"]["MonitoredStopVisit"][0]
        ["MonitoredVehicleJourney"]["MonitoredCall"]["ExpectedDepartureTime"] = true;
  filter["ServiceDelivery"]["StopMonitoringDelivery"]["MonitoredStopVisit"][0]
        ["MonitoredVehicleJourney"]["MonitoredCall"]["ExpectedArrivalTime"] = true;
  filter["ServiceDelivery"]["StopMonitoringDelivery"]["MonitoredStopVisit"][0]
        ["MonitoredVehicleJourney"]["MonitoredCall"]["AimedDepartureTime"] = true;

  JsonDocument doc;
  DeserializationError err =
      deserializeJson(doc, text, DeserializationOption::Filter(filter));
  if (json) free(json);
  if (err) return false;

  predCount = 0;
  time_t now = time(nullptr);
  JsonArray visits = doc["ServiceDelivery"]["StopMonitoringDelivery"]
                        ["MonitoredStopVisit"].as<JsonArray>();
  for (JsonObject v : visits) {
    JsonObject mvj = v["MonitoredVehicleJourney"];
    const char* line = mvj["LineRef"];
    if (line && strcmp(line, LINE_REF) != 0) continue;
    // Muni often only fills ExpectedArrivalTime at mid-route stops; that's
    // the real-time prediction. AimedDepartureTime is just the schedule.
    const char* t = mvj["MonitoredCall"]["ExpectedDepartureTime"];
    if (!t) t = mvj["MonitoredCall"]["ExpectedArrivalTime"];
    if (!t) t = mvj["MonitoredCall"]["AimedDepartureTime"];
    if (!t) continue;
    time_t dep = parseIso8601Utc(t);
    if (dep <= now) continue;
    // "12065578_M11" -> 12065578; used to match against schedule.h trips
    const char* ref = mvj["FramedVehicleJourneyRef"]["DatedVehicleJourneyRef"];
    uint32_t trip = ref ? strtoul(ref, nullptr, 10) : 0;
    if (predCount < MAX_PREDICTIONS) {
      predTimes[predCount] = dep;
      predTrips[predCount] = trip;
      predCount++;
    }
  }
  predFreshMs = millis();
  return true;
}

// ======================= SCHEDULE MERGE =======================
// 511 StopMonitoring only lists actively tracked buses; untracked trips are
// simply absent (apps show them as scheduled/"on time"). Merge the baked-in
// GTFS schedule with live predictions, matching trips by id so a tracked
// bus never appears twice. Predictions win for their trip.
void buildDepartures() {
  time_t now = time(nullptr);
  bool predsFresh = predCount > 0 && (millis() - predFreshMs) < 5UL * 60UL * 1000UL;

  time_t cand[MAX_PREDICTIONS + MAX_DEPARTURES + 2];
  uint8_t n = 0;

  if (predsFresh) {
    for (uint8_t i = 0; i < predCount; i++)
      if (predTimes[i] > now && n < (uint8_t)(sizeof(cand) / sizeof(cand[0])))
        cand[n++] = predTimes[i];
  }

  struct tm lt;
  localtime_r(&now, &lt);
  long dayIdx = daysFromCivil(lt.tm_year + 1900, lt.tm_mon + 1, lt.tm_mday) - sched.firstDay;
  if (dayIdx >= 0 && dayIdx < sched.dayCount && sched.dayPattern[dayIdx] >= 0 &&
      sched.dayPattern[dayIdx] < sched.patternCount) {
    int8_t p = sched.dayPattern[dayIdx];
    struct tm mid = lt;
    mid.tm_hour = 0; mid.tm_min = 0; mid.tm_sec = 0; mid.tm_isdst = -1;
    time_t midnight = mktime(&mid);
    uint8_t added = 0;
    for (uint16_t i = 0; i < sched.patLen[p] && added < MAX_DEPARTURES + 2; i++) {
      time_t dep = midnight + (time_t)sched.minutes[p][i] * 60;
      if (dep <= now) continue;
      bool tracked = false;
      if (predsFresh) {
        for (uint8_t j = 0; j < predCount; j++)
          if (predTrips[j] != 0 && predTrips[j] == sched.trips[p][i]) { tracked = true; break; }
      }
      if (tracked) continue;  // live prediction covers this trip
      if (n < (uint8_t)(sizeof(cand) / sizeof(cand[0]))) { cand[n++] = dep; added++; }
    }
  } else {
    static bool warned = false;
    if (!warned) { Serial.println("schedule out of date range - predictions only"); warned = true; }
  }

  // insertion sort (n is tiny), then keep the first MAX_DEPARTURES
  for (uint8_t i = 1; i < n; i++) {
    time_t v = cand[i];
    int8_t j = i - 1;
    while (j >= 0 && cand[j] > v) { cand[j + 1] = cand[j]; j--; }
    cand[j + 1] = v;
  }
  departureCount = n < MAX_DEPARTURES ? n : MAX_DEPARTURES;
  for (uint8_t i = 0; i < departureCount; i++) departures[i] = cand[i];
}

// ======================= RENDER =======================
// Landscape 250x122: "23" badge left, big minutes center, next bus below
void render(int minutes, int minutes2, bool fullRefresh) {
  // Layout constants (keep in sync with preview/preview.py draw_layout_v2).
  // Centered on the widest state "NOW": badge 62 + gap 16 + 117 = 195 wide
  // -> badge x = 27, text column x = 105.
  const int16_t BASE = 77;      // shared baseline: badge "23", number, NOW, No buses
  const int16_t SUB_BASE = 112; // bottom info line baseline
  const int16_t LEFT = 105;     // left edge of the text column

  canvas.fillScreen(0);  // white
  canvas.setTextColor(1);

  // Route badge; "23" is 52px wide in FreeSansBold24pt -> x = 27+(62-52)/2 = 32
  canvas.fillRoundRect(27, 30, 62, 62, 8, 1);
  canvas.setFont(&FreeSansBold24pt7b);
  canvas.setTextColor(0);
  canvas.setCursor(32, BASE);
  canvas.print("23");
  canvas.setTextColor(1);

  if (minutes < 0) {
    canvas.setFont(&FreeSansBold12pt7b);
    canvas.setCursor(LEFT, BASE);
    canvas.print(fetchOk ? "No buses" : "No data");
  } else if (minutes == 0) {
    canvas.setFont(&FreeSansBold24pt7b);
    canvas.setCursor(LEFT, BASE);
    canvas.print("NOW");
  } else {
    canvas.setFont(&FreeSansBold24pt7b);
    canvas.setCursor(LEFT, BASE);
    canvas.print(minutes);
    canvas.setFont(&FreeSansBold12pt7b);
    canvas.setCursor(canvas.getCursorX() + 6, BASE);
    canvas.print("min");
  }

  canvas.setFont(&FreeSans9pt7b);
  canvas.setCursor(LEFT, SUB_BASE);
  if (minutes2 >= 0) {
    canvas.print("next: ");
    canvas.print(minutes2);
    canvas.print(" min");
  } else {
    canvas.print("Glen Park");
  }

  canvasToPanel();
  uint32_t t0 = millis();
  EPD1680_Init();  // wakes the panel; RAM (previous frame) survives sleep
  if (fullRefresh) {
    EPD1680_DisplayFull(epdBuf);
    partialsSinceFull = 0;
  } else {
    EPD1680_DisplayPartial(epdBuf);
    partialsSinceFull++;
  }
  EPD1680_Sleep();
  Serial.printf("Render (%s) took %lu ms\n", fullRefresh ? "full" : "partial",
                (unsigned long)(millis() - t0));
}

// ======================= SETUP / LOOP =======================
void setup() {
  Serial.begin(115200);
  delay(500);

  EPD1680_PowerOn();

  // Boot splash before any network: proves the panel works on its own
  Serial.println("Boot splash render...");
  canvas.fillScreen(0);
  canvas.fillRoundRect(27, 30, 62, 62, 8, 1);
  canvas.setFont(&FreeSansBold24pt7b);
  canvas.setTextColor(0);
  canvas.setCursor(32, 77);
  canvas.print("23");
  canvas.setTextColor(1);
  canvas.setFont(&FreeSans9pt7b);
  canvas.setCursor(105, 77);
  canvas.print("starting up...");
  canvasToPanel();
  EPD1680_Init();
  EPD1680_DisplayFull(epdBuf);
  EPD1680_Sleep();
  Serial.println("Boot splash done");

  WiFi.mode(WIFI_STA);
  WiFi.begin(WIFI_SSID, WIFI_PASS);
  while (WiFi.status() != WL_CONNECTED) { delay(250); Serial.print("."); }
  Serial.println("\nWiFi connected");

  configTzTime(TZ_STRING, "pool.ntp.org", "time.google.com");
  Serial.println("Waiting for NTP...");
  while (time(nullptr) < 1600000000) delay(200);  // wait for NTP
  Serial.println("NTP synced");

  initSchedule();
  if (fetchRemoteSchedule()) schedRetryMs = 24UL * 60UL * 60UL * 1000UL;
  else schedRetryMs = 60UL * 60UL * 1000UL;
  lastSchedFetchMs = millis();

  fetchOk = fetchPredictions();
  Serial.printf("Fetch %s, %u live predictions\n", fetchOk ? "OK" : "FAILED", predCount);
  lastFetchMs = millis();
  updateDisplay(true);
  Serial.printf("Merged: %u departures", departureCount);
  time_t now = time(nullptr);
  for (uint8_t i = 0; i < departureCount; i++)
    Serial.printf("  +%ldmin", (long)((departures[i] - now) / 60));
  Serial.println();
}

void updateDisplay(bool forceFull) {
  time_t now = time(nullptr);

  // Rebuild from schedule + fresh predictions; also drops passed departures
  buildDepartures();

  int m1 = departureCount > 0 ? (int)((departures[0] - now) / 60) : -1;
  int m2 = departureCount > 1 ? (int)((departures[1] - now) / 60) : -1;

  if (forceFull || m1 != lastShownMinutes) {
    bool full = forceFull || partialsSinceFull >= FULL_REFRESH_EVERY;
    render(m1, m2, full);
    lastShownMinutes = m1;
  }
}

void loop() {
  if (millis() - lastFetchMs >= FETCH_INTERVAL_MS) {
    if (WiFi.status() != WL_CONNECTED) WiFi.reconnect();
    fetchOk = fetchPredictions();
    lastFetchMs = millis();
  }
  if (millis() - lastSchedFetchMs >= schedRetryMs) {
    schedRetryMs = fetchRemoteSchedule() ? 24UL * 60UL * 60UL * 1000UL
                                         : 60UL * 60UL * 1000UL;  // retry hourly on failure
    lastSchedFetchMs = millis();
  }
  updateDisplay(false);
  delay(1000);
}
